## main/Kconfig.projbuild
```kconfig
menu "UnitatControlEnllumenat"

    config WIFI_SSID
        string "WiFi SSID"
        default "MySSID"
        help
            SSID de la xarxa WiFi a la qual es connectarà l'ESP32.

    config WIFI_PASSWORD
        string "WiFi Password"
        default "MyPassword"
        help
            Contrasenya de la xarxa WiFi.

endmenu
```

## sdkconfig.defaults
```kconfig
# ── QP/C++ FreeRTOS port ──────────────────────────────────────────────────────
# El port requereix configMAX_PRIORITIES >= QF_MAX_ACTIVE (32).
# ESP-IDF per defecte usa 25; el pugem a 33.
CONFIG_FREERTOS_MAX_PRIORITIES=33

# ── Mongoose (thread via std::thread → pthread) ───────────────────────────────
# Stack per defecte de pthread insuficient per al bucle de Mongoose.
CONFIG_PTHREAD_TASK_STACK_SIZE_DEFAULT=16384

# ── esp_timer task ────────────────────────────────────────────────────────────
# qp_tick_cb crida TICK_X que pot disparar events a tots els AOs via xTaskNotify.
CONFIG_ESP_TIMER_TASK_STACK_SIZE=8192

# ── FreeRTOS stack overflow detection ─────────────────────────────────────────
# Mode 2: verifica canary al final del stack per detectar desbordaments.
CONFIG_FREERTOS_CHECK_STACKOVERFLOW=2

# ── C++ ───────────────────────────────────────────────────────────────────────
# Necessari per std::mutex, STL, etc.
CONFIG_COMPILER_CXX_EXCEPTIONS=y

# ── lwIP ─────────────────────────────────────────────────────────────────────
# Noms POSIX de sockets (read/write/close) per a compatibilitat amb Mongoose.
CONFIG_LWIP_POSIX_SOCKETS_IO_NAMES=y
```
